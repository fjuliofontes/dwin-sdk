## Kconfig
```kconfig
menu "DWIN display SDK"

config DWIN_OTA_HTTP
    bool "Build the HTTP(S) OTA client"
    default y
    select ESP_HTTP_CLIENT_ENABLE_HTTPS if ESP_TLS_USING_MBEDTLS
    help
      Build dwin_ota_http, a convenience layer that downloads a .dwpk bundle
      over HTTP(S) and streams its files into the display NOR flash. Disable
      it if you feed dwin_ota_bundle from another transport.

config DWIN_OTA_BUNDLE_MAX_FILES
    int "Maximum number of files in an OTA bundle"
    default 16
    range 1 64
    help
      Largest number of DGUS files one .dwpk bundle may carry. The file table
      is kept in RAM for the whole transfer, 16 bytes per file.

config DWIN_OTA_WRITE_RETRIES
    int "Retries of an unacknowledged OTA data frame"
    default 3
    range 0 10
    help
      Times a write to the display update space is sent again when the display
      does not acknowledge it, before the update is abandoned.

config DWIN_NOR_FLASH_WAIT_READY
    bool "Poll the display instead of waiting 6 s per flash block (experimental)"
    default n
    help
      By default the driver waits a fixed 6 seconds between two 32KB flash
      commits. With this option it polls the display until the commit is
      reported as done, which is much faster. Check it on your display before
      shipping it.

config DWIN_CMD_SIZE
    int "Command response buffer size"
    default 50
    range 16 512
    help
      Scratch buffer used for the display replies. A read of N words needs
      6 + 2 * N bytes.

config DWIN_RESPONSE_TIMEOUT_MS
    int "Response timeout (ms)"
    default 500
    range 50 5000
    help
      How long to wait for an ACK or a read reply from the display.

config DWIN_MUTEX_TIMEOUT_MS
    int "Bus mutex timeout (ms)"
    default 100
    range 10 10000
    help
      How long a caller waits for the display bus to become free.

endmenu
```

## zephyr/Kconfig
```kconfig
# SPDX-License-Identifier: MIT

menuconfig DWIN
    bool "DWIN DGUS display SDK"
    help
      Driver and OTA SDK for DWIN DGUS displays.

if DWIN

config DWIN_PORT
    bool "Build the Zephyr UART port"
    default y
    depends on SERIAL
    select UART_INTERRUPT_DRIVEN
    help
      Ready made bus IO glue on top of the interrupt driven UART API. The
      display UART is taken from the display-uart devicetree alias unless one
      is passed to dwin_port_init().

config DWIN_RING_BUFFER_SIZE
    int "RX ring buffer size"
    default 50
    depends on DWIN_PORT
    range 16 512
    help
      Size of the software RX ring buffer filled by the UART interrupt.

config DWIN_OTA_DOWNLOADER
    bool "Build the downloader based OTA client"
    default n
    depends on DOWNLOADER
    help
      Convenience layer that pulls a .dwpk bundle with the nRF Connect SDK
      downloader library and streams its files into the display NOR flash.

config DWIN_OTA_SOCKET_RETRIES
    int "Socket retries per bundle"
    default 2
    depends on DWIN_OTA_DOWNLOADER

config DWIN_OTA_SEC_TAG_LIST_SIZE_MAX
    int "Maximum number of TLS security tags"
    default 1
    depends on DWIN_OTA_DOWNLOADER

config DWIN_OTA_DOWNLOADER_BUF_SIZE
    int "Downloader buffer size"
    default 2160
    depends on DWIN_OTA_DOWNLOADER
    help
      Buffer handed to the downloader library.

config DWIN_OTA_BUNDLE_MAX_FILES
    int "Maximum number of files in an OTA bundle"
    default 16
    range 1 64
    help
      Largest number of DGUS files one .dwpk bundle may carry. The file table
      is kept in RAM for the whole transfer, 16 bytes per file.

config DWIN_OTA_WRITE_RETRIES
    int "Retries of an unacknowledged OTA data frame"
    default 3
    range 0 10
    help
      Times a write to the display update space is sent again when the display
      does not acknowledge it, before the update is abandoned.

config DWIN_NOR_FLASH_WAIT_READY
    bool "Poll the display instead of waiting 6 s per flash block (experimental)"
    default n
    help
      By default the driver waits a fixed 6 seconds between two 32KB flash
      commits. With this option it polls the display until the commit is
      reported as done, which is much faster. Check it on your display before
      shipping it.

config DWIN_CMD_SIZE
    int "Command response buffer size"
    default 50
    range 16 512

config DWIN_RESPONSE_TIMEOUT_MS
    int "Response timeout (ms)"
    default 500
    range 50 5000

config DWIN_MUTEX_TIMEOUT_MS
    int "Bus mutex timeout (ms)"
    default 100
    range 10 10000

module = DWIN
module-str = DWIN
source "subsys/logging/Kconfig.template.log_config"

endif # DWIN
```
